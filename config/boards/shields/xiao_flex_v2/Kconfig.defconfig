## config/boards/shields/xiao_flex_v2/Kconfig.defconfig
```kconfig
if SHIELD_XIAO_FLEX_V2_DONGLE

config ZMK_KEYBOARD_NAME
    default "xiao_flex_v2"

config ZMK_SPLIT_ROLE_CENTRAL
    default y

config ZMK_USB
    default y

endif

if SHIELD_XIAO_FLEX_V2

config ZMK_SPLIT
    default y

config ZMK_BLE
    default y

endif
```
